## examples/mjpeg/Kconfig
```kconfig
#
# For a description of the syntax of this configuration file,
# see the file kconfig-language.txt in the NuttX tools repository.
#

config EXAMPLES_MJPEG
	bool "Motion JPEG example"
	default n
	---help---
		Enable the camera example

if EXAMPLES_MJPEG

config EXAMPLES_MJPEG_PROGNAME
	string "Program name"
	default "mjpeg"
	depends on BUILD_KERNEL
	---help---
		This is the name of the program that will be use when the NSH ELF
		program is installed.

config EXAMPLES_MJPEG_PRIORITY
	int "Camera task priority"
	default 100

config EXAMPLES_MJPEG_STACKSIZE
	int "Camera stack size"
	default 2048

config EXAMPLES_MJPEG_OUTPUT_LCD
	bool "Output LCD"

endif
```

## examples/wavelet/Kconfig
```kconfig
#
# For a description of the syntax of this configuration file,
# see the file kconfig-language.txt in the NuttX tools repository.
#

config EXAMPLES_WAVELET
	bool "WAVELET Example"
	default n
	depends on ASMP && EXTERNALS_CMSIS_DSP
	---help---
		Fast Fourier Transform offload to DSP

if EXAMPLES_WAVELET

choice
	prompt "WAVELET Input Data"
	default EXAMPLES_WAVELET_REAL_DATA

config EXAMPLES_WAVELET_REAL_DATA
	bool "Real data"

config EXAMPLES_WAVELET_COMPLEX_DATA
	bool "Complex data"

endchoice

config EXAMPLES_WAVELET_DSP_PATH
	string "DSP ELF file path"
	default "/mnt/sd0/BIN/DSPWAVELET"
	---help---
		Set path to DSPWAVELET worker program ELF file on the board.

config EXAMPLES_WAVELET_SAMPLES_WORK_BUFFER_SIZE
	hex "Work buffer size"
	default 0x2000
	---help---
		The work buffer for WAVELET calculation. The actual memory size
		is CONFIG_EXAMPLES_WAVELET_SAMPLES_WORK_BUFFER_SIZE x 4 bytes.

config EXAMPLES_WAVELET_SAMPLES_INPUT_BUFFER_SIZE
	hex "Input buffer size"
	default 0x1000
	---help---
		The input buffer for WAVELET calculation. The actual memory size
		is CONFIG_EXAMPLES_WAVELET_SAMPLES_INPUT_BUFFER_SIZE x 4 bytes.

endif # EXAMPLES_WAVELET
```

## externals/nrf52/Kconfig
```kconfig
#
# For a description of the syntax of this configuration file,
# see the file kconfig-language.txt in the NuttX tools repository.
#

config EXTERNALS_NRF52
	bool "NRF52 Libraries"
	default n
	---help---
		Enable NRF52 Libraries.
		from https://www.nordicsemi.com/Products/Development-software/nRF5-SDK/Download
		For details, see https://infocenter.nordicsemi.com/index.jsp?topic=%2Fstruct_sdk%2Fstruct%2Fsdk_nrf5_latest.html .

if EXTERNALS_NRF52

choice
	prompt "nRF52xxx & Soft Device"
	default BLUETOOTH_NRF52_S132

config BLUETOOTH_NRF52_S132
	bool "Select nRF52832 & SoftDevice S132"

endchoice

if BLUETOOTH_NRF52_UART2

config UART2_PARITY
	int "Parity setting"
	default 2
	range 0 2
	---help---
		0=no parity, 1=odd parity, 2=even parity
endif

endif # EXTERNALS_NRF52
```

## sdk/configs/examples/audio_oscillator-defconfig
```kconfig
CONFIG_CXD56_SDIO=y
CONFIG_CXD56_AUDIO=y
CONFIG_SDK_AUDIO=y
CONFIG_AUDIOUTILS_MANAGER=y
CONFIG_AUDIOUTILS_DSP_MOUNTPT="/mnt/sd0/BIN"
CONFIG_AUDIOUTILS_SYNTHESIZER=y
CONFIG_MEMUTILS=y
CONFIG_MEMUTILS_MEMORY_MANAGER=y
CONFIG_MEMUTILS_MESSAGE=y
CONFIG_MEMUTILS_S_STL=y
CONFIG_MEMUTILS_SIMPLE_FIFO=y
CONFIG_ASMP=y
CONFIG_EXAMPLES_AUDIO_OSCILLATOR=y
CONFIG_EXAMPLES_AUDIO_OSCILLATOR_USEPREPROC=y
CONFIG_EXTERNALS_CMSIS=y
CONFIG_EXTERNALS_CMSIS_DSP_FFT_LENGTH_4096_DISABLE=y
```

## sdk/configs/examples/mjpeg-defconfig
```kconfig
CONFIG_CXD56_I2C=y
CONFIG_CXD56_I2C2=y
CONFIG_CXD56_CISIF=y
CONFIG_VIDEO=y
CONFIG_VIDEO_ISX012=y
CONFIG_CXD56_SDIO=y
CONFIG_AVI_COONTAINER=y
CONFIG_EXAMPLES_MJPEG=y
```

## sdk/configs/examples/wavelet-defconfig
```kconfig
CONFIG_CXD56_SDIO=y
CONFIG_ASMP=y
CONFIG_EXTERNALS_CMSIS=y
CONFIG_EXTERNALS_CMSIS_DSP_FFT_LENGTH_4096_DISABLE=y
CONFIG_EXAMPLES_WAVELET=y
```

## sdk/modules/bluetooth/hal/nrf52/Kconfig
```kconfig
#
# For a description of the syntax of this configuration file,
# see the file kconfig-language.txt in the NuttX tools repository.
#


config BLUETOOTH_NRF52
	bool "Nordic nRF52 series"
	default n
	---help---
		Nordic nRF52 provides BLE interfaces for application.

if BLUETOOTH_NRF52

choice
	prompt "nRF52xxx & Soft Device"
	default BLUETOOTH_NRF52_S132

config BLUETOOTH_NRF52_S132
	bool "Select nRF52832 & SoftDevice S132"

config BLUETOOTH_NRF52_S140
	bool "Select nRF52840 & SoftDevice S140"

endchoice

choice
	prompt "Connected Interface"
	default BLUETOOTH_NRF52_UART2

config BLUETOOTH_NRF52_UART0
	bool "nRF52 via UART0"
	select CONFIG_CXD56_FARAPI

config BLUETOOTH_NRF52_UART2
	bool "nRF52 via UART2"
	select CONFIG_CXD56_UART2

endchoice

if BLUETOOTH_NRF52_UART2

config UART2_PARITY
	int "Parity setting"
	default 2
	range 0 2
	---help---
		0=no parity, 1=odd parity, 2=even parity

endif

endif
```

## sdk/modules/container/Kconfig
```kconfig
#
# For a description of the syntax of this configuration file,
# see the file kconfig-language.txt in the NuttX tools repository.
#

menu "AVI container Libraries"

config AVI_COONTAINER
	bool "Spresense AVI container Libraries"
	default n

endmenu
```
